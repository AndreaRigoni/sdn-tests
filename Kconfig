## Kconfig
```kconfig
# ////////////////////////////////////////////////////////////////////////// //
#
# This file is part of the autoconf-bootstrap project.
# Copyright 2018 Andrea Rigoni Garola <andrea.rigoni@igi.cnr.it>.
#
# This program is free software: you can redistribute it and/or modify
# it under the terms of the GNU General Public License as published by
# the Free Software Foundation, either version 3 of the License, or
# (at your option) any later version.
#
# This program is distributed in the hope that it will be useful,
# but WITHOUT ANY WARRANTY; without even the implied warranty of
# MERCHANTABILITY or FITNESS FOR A PARTICULAR PURPOSE.  See the
# GNU General Public License for more details.
#
# You should have received a copy of the GNU General Public License
# along with this program.  If not, see <http://www.gnu.org/licenses/>.
#
# ////////////////////////////////////////////////////////////////////////// //



#
# For a description of the syntax of this configuration file,
# see Documentation/kbuild/kconfig-language.txt.
#
mainmenu "dan-tests"


comment "Build Options"

# //////////////////////////////////////////////////////////////////////////// #
# //  BUILD_COMMON  ////////////////////////////////////////////////////////// #
# //////////////////////////////////////////////////////////////////////////// #

  source conf/kscripts/build_common.kconfig

# //////////////////////////////////////////////////////////////////////////// #
# //  TOOLCHAIN  ///////////////////////////////////////////////////////////// #
# //////////////////////////////////////////////////////////////////////////// #

  source conf/kscripts/toolchain.kconfig

# //////////////////////////////////////////////////////////////////////////// #
# //  DOCKER  //////////////////////////////////////////////////////////////// #
# //////////////////////////////////////////////////////////////////////////// #

  source conf/kscripts/docker.kconfig

# //////////////////////////////////////////////////////////////////////////// #
# //  QT  //////////////////////////////////////////////////////////////////// #
# //////////////////////////////////////////////////////////////////////////// #

  source conf/kscripts/qtdesktop.kconfig

# //////////////////////////////////////////////////////////////////////////// #
# //  NODEJS  //////////////////////////////////////////////////////////////// #
# //////////////////////////////////////////////////////////////////////////// #

  source conf/kscripts/nodejs.kconfig

# //////////////////////////////////////////////////////////////////////////// #
# //  DOXYGEN  /////////////////////////////////////////////////////////////// #
# //////////////////////////////////////////////////////////////////////////// #

  source conf/autoconf-doxygen/doxygen.kconfig

# ////////////////////////////////////////////////////////////////////////////////
# //  ITER CODAC  ////////////////////////////////////////////////////////////////
# ////////////////////////////////////////////////////////////////////////////////

  source conf/kscripts/iter_codac.kconfig

# //////////////////////////////////////////////////////////////////////////// #
# //  EXT  /////////////////////////////////////////////////////////////////// #
# //////////////////////////////////////////////////////////////////////////// #

menuconfig  ENABLE_EXTSRC
	 bool "ext sources"
	 default y
	 ---help---
	  Enable optional external software sources to be embedded in project

if ENABLE_EXTSRC

  # //  CCSTICKERS  //
  source conf/kscripts/ext_ccStickers.kconfig

  # //  JSONRPCC  //
  source conf/kscripts/ext_jsonrpcc.kconfig

  # //  FIO  //
  source conf/kscripts/ext_fio.kconfig

  # //  MDSPLUS  //
  source conf/kscripts/ext_mdsplus.kconfig

endif # ENABLE_EXTSRC


# //////////////////////////////////////////////////////////////////////////// #
# //  YOCTO  ///////////////////////////////////////////////////////////////// #
# //////////////////////////////////////////////////////////////////////////// #

  source conf/kscripts/yocto.kconfig
```
